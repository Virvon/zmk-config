&spi1 {
    status = "okay";
    nice_view: nice_view@0 {
        compatible = "ilitek,ili9341";
        reg = <0>;
        spi-max-frequency = <24000000>;
        dc-gpios = <&gpio0 27 GPIO_ACTIVE_HIGH>;
        rst-gpios = <&gpio1 11 GPIO_ACTIVE_HIGH>;
        rotation = <270>;
    };
};